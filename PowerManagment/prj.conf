## CMakeLists.txt
```
cmake_minimum_required(VERSION 3.20.0)
find_package(Zephyr REQUIRED HINTS $ENV{ZEPHYR_BASE})
project(zephyr_power_management)
target_sources(app PRIVATE src/main.c)
```

## prj.conf
```kconfig
# Enable power management
CONFIG_PM=y

# Enable logging (optional, for debugging)
CONFIG_LOG=y
CONFIG_LOG_DEFAULT_LEVEL=3
```

## src/main.c
```c
#include <zephyr/pm/pm.h>         // For power management functions
#include <zephyr/pm/pm_state.h>   // For power state definitions
#include <zephyr/kernel.h>

void main(void)
{
    printk("Forcing deep sleep...\n");

    // Force the device into a deep sleep (soft-off) state
    pm_state_force(0, &(struct pm_state_info){
        .state = PM_STATE_SOFT_OFF,
        .substate_id = 0
    });

    printk("Device is now in deep sleep mode.\n");
}
```
